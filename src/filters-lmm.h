// generated by LLM

#include <Arduino.h>
#include <arduinoFFT.h>
#include <vector>
#include <numeric>
#include <algorithm>

#define SAMPLES 256 // Must be a power of 2

class DSPProcessor {
public:
    ArduinoFFT<double> FFT;
    double vReal[SAMPLES];
    double vImag[SAMPLES];

    // Hampel Filter: Robust outlier detection using Median Absolute Deviation (MAD)
    void applyHampelFilter(double* data, int length, int windowSize = 7, double threshold = 3.0) {
        std::vector<double> filtered(length);
        int halfWindow = windowSize / 2;

        for (int i = 0; i < length; i++) {
            int start = std::max(0, i - halfWindow);
            int end = std::min(length - 1, i + halfWindow);
            std::vector<double> window;
            for (int j = start; j <= end; j++) window.push_back(data[j]);

            std::sort(window.begin(), window.end());
            double median = window[window.size() / 2];
            
            double mad = 0;
            for (double val : window) mad += abs(val - median);
            mad /= window.size();

            if (abs(data[i] - median) > threshold * (1.4826 * mad)) {
                data[i] = median; // Replace outlier with median
            }
        }
    }

    double identifyMaxFrequency(double samplingFreq) {
        FFT = ArduinoFFT<double>(vReal, vImag, SAMPLES, samplingFreq);
        FFT.windowing(FFT_WIN_TYP_HAMMING, FFT_FORWARD);
        FFT.compute(FFT_FORWARD);
        FFT.complexToMagnitude();
        return FFT.majorPeak();
    }
};