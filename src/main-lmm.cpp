// this is the main.cpp as generated by an LLM

#include <WiFi.h>
#include <PubSubClient.h>
#include <lmic.h>
#include <hal/hal.h>
#include "filters-lmm.h"

// Task Handles
TaskHandle_t xSamplingTask;
SemaphoreHandle_t xDataMutex;

// Global Variables
double currentSamplingFreq = 100.0; // Start at 100Hz
double buffer[SAMPLES];
int sampleIdx = 0;
DSPProcessor dsp;

// --- Task 1: Adaptive Sampling (High Priority) ---
void samplingTask(void *pvParameters) {
    TickType_t xLastWakeTime = xTaskGetTickCount();
    for (;;) {
        // Simulate Input: 2*sin(2*pi*3*t) + 4*sin(2*pi*5*t) + Noise + Anomaly
        double t = millis() / 1000.0;
        double signal = 2*sin(2*PI*3*t) + 4*sin(2*PI*5*t);
        
        // Add random anomaly (Bonus requirement)
        if (random(0, 100) < 2) signal += random(5, 15); 

        if (xSemaphoreTake(xDataMutex, portMAX_DELAY)) {
            buffer[sampleIdx++] = signal;
            xSemaphoreGive(xDataMutex);
        }

        // Adaptive Delay based on currentSamplingFreq
        vTaskDelayUntil(&xLastWakeTime, pdMS_TO_TICKS(1000.0 / currentSamplingFreq));
    }
}

// --- Task 2: Analysis & Communication ---
void analysisTask(void *pvParameters) {
    for (;;) {
        if (sampleIdx >= SAMPLES) {
            xSemaphoreTake(xDataMutex, portMAX_DELAY);
            
            // 1. Copy buffer for processing
            for(int i=0; i<SAMPLES; i++) {
                dsp.vReal[i] = buffer[i];
                dsp.vImag[i] = 0;
            }
            sampleIdx = 0;
            xSemaphoreGive(xDataMutex);

            // 2. Filter Anomalies
            dsp.applyHampelFilter(dsp.vReal, SAMPLES);

            // 3. Compute Aggregate (Average)
            double sum = 0;
            for(int i=0; i<SAMPLES; i++) sum += dsp.vReal[i];
            double average = sum / SAMPLES;

            // 4. Adapt Frequency
            double peakFreq = dsp.identifyMaxFrequency(currentSamplingFreq);
            currentSamplingFreq = std::max(10.0, peakFreq * 2.2); // Nyquist + Margin

            // 5. Transmit (MQTT & LoRaWAN)
            Serial.printf("Avg: %.2f | Peak Freq: %.2f | New Sampling Freq: %.2f\n", 
                          average, peakFreq, currentSamplingFreq);
            
            // Logic for MQTT Publish and LoRaWAN queueing would go here
        }
        vTaskDelay(pdMS_TO_TICKS(100)); // Check buffer every 100ms
    }
}

void setup() {
    Serial.begin(115200);
    xDataMutex = xSemaphoreCreateMutex();

    xTaskCreatePinnedToCore(samplingTask, "Sampler", 4096, NULL, 3, &xSamplingTask, 1);
    xTaskCreatePinnedToCore(analysisTask, "Analyzer", 8192, NULL, 1, NULL, 0);
}

void loop() { 
    // FreeRTOS handles tasks; loop stays empty or handles LoRaWAN/WiFi state machines
}